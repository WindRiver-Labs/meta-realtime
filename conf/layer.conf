## conf/layer.conf
```bitbake
# We have a conf and classes directory, add to BBPATH
BBPATH .= ":${LAYERDIR}"

# We have recipes-* directories, add to BBFILES
BBFILES += "${LAYERDIR}/recipes-*/*/*.bb \
            ${LAYERDIR}/recipes-*/*/*.bbappend"

BBFILE_COLLECTIONS += "realtime"
BBFILE_PATTERN_realtime := "^${LAYERDIR}/"
BBFILE_PRIORITY_realtime = "5"

# Additional license directories.
# LICENSE_PATH += "${LAYERDIR}/custom-licenses"

# This should only be incremented on significant changes that will
# cause compatibility issues with other layers
LAYERVERSION_realtime = "1"

LAYERDEPENDS_realtime = "core"
```
